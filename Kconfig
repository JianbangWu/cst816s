## Kconfig
```kconfig
# Kconfig file for package cst816s
menuconfig PKG_USING_CST816S
    bool "cst816s touch drivers for RT-Thread"
    default n

if PKG_USING_CST816S

    config PKG_CST816S_PATH
        string
        default "/packages/peripherals/touch/cst816s"

    choice
        prompt "Version"
        help
            Select the package version

        config PKG_USING_CST816S_V100
            bool "v1.0.0"

        config PKG_USING_CST816S_LATEST_VERSION
            bool "latest"
    endchoice

    config PKG_CST816S_VER
       string
       default "v1.0.0"    if PKG_USING_CST816S_V100
       default "latest"    if PKG_USING_CST816S_LATEST_VERSION

endif
```
